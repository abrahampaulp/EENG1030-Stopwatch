#include "st7735.h"

static SPI_HandleTypeDef *_hspi;

/* Pin macros */
#define CS_LOW()   HAL_GPIO_WritePin(GPIOA, GPIO_PIN_4, GPIO_PIN_RESET)
#define CS_HIGH()  HAL_GPIO_WritePin(GPIOA, GPIO_PIN_4, GPIO_PIN_SET)
#define DC_LOW()   HAL_GPIO_WritePin(GPIOA, GPIO_PIN_8, GPIO_PIN_RESET)
#define DC_HIGH()  HAL_GPIO_WritePin(GPIOA, GPIO_PIN_8, GPIO_PIN_SET)
#define RST_LOW()  HAL_GPIO_WritePin(GPIOB, GPIO_PIN_0, GPIO_PIN_RESET)
#define RST_HIGH() HAL_GPIO_WritePin(GPIOB, GPIO_PIN_0, GPIO_PIN_SET)

/* ST7735S commands */
#define CMD_SWRESET 0x01
#define CMD_SLPOUT  0x11
#define CMD_NORON   0x13
#define CMD_INVOFF  0x20
#define CMD_DISPON  0x29
#define CMD_CASET   0x2A
#define CMD_RASET   0x2B
#define CMD_RAMWR   0x2C
#define CMD_MADCTL  0x36
#define CMD_COLMOD  0x3A
#define CMD_FRMCTR1 0xB1
#define CMD_FRMCTR2 0xB2
#define CMD_FRMCTR3 0xB3
#define CMD_INVCTR  0xB4
#define CMD_PWCTR1  0xC0
#define CMD_PWCTR2  0xC1
#define CMD_PWCTR3  0xC2
#define CMD_PWCTR4  0xC3
#define CMD_PWCTR5  0xC4
#define CMD_VMCTR1  0xC5
#define CMD_GMCTRP1 0xE0
#define CMD_GMCTRN1 0xE1

/* 5x7 font */
static const uint8_t font5x7[][5] = {
    {0x00,0x00,0x00,0x00,0x00}, /* space */
    {0x00,0x00,0x5F,0x00,0x00}, /* ! */
    {0x00,0x07,0x00,0x07,0x00}, /* " */
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    {0x44,0x64,0x54,0x4C,0x44}, /* z */
};

static void send_cmd(uint8_t cmd)
{
    DC_LOW(); CS_LOW();
    HAL_SPI_Transmit(_hspi, &cmd, 1, HAL_MAX_DELAY);
    CS_HIGH();
}

static void send_data(uint8_t data)
{
    DC_HIGH(); CS_LOW();
    HAL_SPI_Transmit(_hspi, &data, 1, HAL_MAX_DELAY);
    CS_HIGH();
}

static void set_window(uint8_t x0,uint8_t y0,uint8_t x1,uint8_t y1)
{
    send_cmd(CMD_CASET);
    send_data(0x00); send_data(x0+LCD_X_OFFSET);
    send_data(0x00); send_data(x1+LCD_X_OFFSET);
    send_cmd(CMD_RASET);
    send_data(0x00); send_data(y0+LCD_Y_OFFSET);
    send_data(0x00); send_data(y1+LCD_Y_OFFSET);
    send_cmd(CMD_RAMWR);
}

void ST7735_Init(SPI_HandleTypeDef *hspi)
{
    _hspi = hspi;
    RST_LOW(); HAL_Delay(10);
    RST_HIGH(); HAL_Delay(120);

    send_cmd(CMD_SWRESET); HAL_Delay(150);
    send_cmd(CMD_SLPOUT);  HAL_Delay(500);

    send_cmd(CMD_FRMCTR1);
    send_data(0x01); send_data(0x2C); send_data(0x2D);
    send_cmd(CMD_FRMCTR2);
    send_data(0x01); send_data(0x2C); send_data(0x2D);
    send_cmd(CMD_FRMCTR3);
    send_data(0x01); send_data(0x2C); send_data(0x2D);
    send_data(0x01); send_data(0x2C); send_data(0x2D);

    send_cmd(CMD_INVCTR); send_data(0x07);

    send_cmd(CMD_PWCTR1); send_data(0xA2); send_data(0x02); send_data(0x84);
    send_cmd(CMD_PWCTR2); send_data(0xC5);
    send_cmd(CMD_PWCTR3); send_data(0x0A); send_data(0x00);
    send_cmd(CMD_PWCTR4); send_data(0x8A); send_data(0x2A);
    send_cmd(CMD_PWCTR5); send_data(0x8A); send_data(0xEE);
    send_cmd(CMD_VMCTR1); send_data(0x0E);
    send_cmd(CMD_INVOFF);
    send_cmd(CMD_MADCTL); send_data(0xC8);
    send_cmd(CMD_COLMOD); send_data(0x05); HAL_Delay(10);

    const uint8_t gp[] = {0x02,0x1C,0x07,0x12,0x37,0x32,0x29,0x2D,
                           0x29,0x25,0x2B,0x39,0x00,0x01,0x03,0x10};
    send_cmd(CMD_GMCTRP1);
    for(int i=0;i<16;i++) send_data(gp[i]);

    const uint8_t gn[] = {0x03,0x1D,0x07,0x06,0x2E,0x2C,0x29,0x2D,
                           0x2E,0x2E,0x37,0x3F,0x00,0x00,0x02,0x10};
    send_cmd(CMD_GMCTRN1);
    for(int i=0;i<16;i++) send_data(gn[i]);

    send_cmd(CMD_NORON);  HAL_Delay(10);
    send_cmd(CMD_DISPON); HAL_Delay(100);
}

void ST7735_FillRect(uint8_t x,uint8_t y,uint8_t w,uint8_t h,uint16_t color)
{
    if(w==0||h==0) return;
    set_window(x,y,x+w-1,y+h-1);
    uint8_t hi=color>>8, lo=color&0xFF;
    DC_HIGH(); CS_LOW();
    for(uint32_t i=0;i<(uint32_t)w*h;i++){
        HAL_SPI_Transmit(_hspi,&hi,1,HAL_MAX_DELAY);
        HAL_SPI_Transmit(_hspi,&lo,1,HAL_MAX_DELAY);
    }
    CS_HIGH();
}

void ST7735_FillScreen(uint16_t color){ ST7735_FillRect(0,0,LCD_WIDTH,LCD_HEIGHT,color); }
void ST7735_DrawPixel(uint8_t x,uint8_t y,uint16_t color){ ST7735_FillRect(x,y,1,1,color); }

void ST7735_DrawRect(uint8_t x,uint8_t y,uint8_t w,uint8_t h,uint16_t color,uint8_t t)
{
    ST7735_FillRect(x,y,w,t,color);
    ST7735_FillRect(x,y+h-t,w,t,color);
    ST7735_FillRect(x,y,t,h,color);
    ST7735_FillRect(x+w-t,y,t,h,color);
}

void ST7735_DrawHLine(uint8_t x,uint8_t y,uint8_t len,uint16_t color){ ST7735_FillRect(x,y,len,1,color); }
void ST7735_DrawVLine(uint8_t x,uint8_t y,uint8_t len,uint16_t color){ ST7735_FillRect(x,y,1,len,color); }

void ST7735_DrawChar(uint8_t x,uint8_t y,char c,uint16_t fg,uint16_t bg,uint8_t sc)
{
    if(c<32||c>122) c=32;
    const uint8_t *g=font5x7[(uint8_t)(c-32)];
    for(uint8_t col=0;col<5;col++)
        for(uint8_t row=0;row<7;row++)
            ST7735_FillRect(x+col*sc,y+row*sc,sc,sc,(g[col]>>row)&1?fg:bg);
    ST7735_FillRect(x+5*sc,y,sc,7*sc,bg);
}

void ST7735_DrawString(uint8_t x,uint8_t y,const char *s,uint16_t fg,uint16_t bg,uint8_t sc)
{
    while(*s){
        if(x+6*sc>LCD_WIDTH) break;
        ST7735_DrawChar(x,y,*s++,fg,bg,sc);
        x+=6*sc;
    }
}